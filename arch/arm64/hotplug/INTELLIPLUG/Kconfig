## arch/arm64/hotplug/INTELLIPLUG/Kconfig
```kconfig
config INTELLI_PLUG
	   bool "Hotplug"
	   depends on MSM_RUN_QUEUE_STATS
	   default y
	   help
		 This enables kernel based multi core control.
```
